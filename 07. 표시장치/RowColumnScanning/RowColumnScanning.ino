/*
 8x8 LED 매트릭스 표시 장치

 이 스케치는 8x8 LED 매트릭스 표시 장치에 하트 모양을 나타내는
 예제입니다.

 2009년 05월 27일 창작되었으며
 2011년 08월 30일 Tom Igoe에 의하여 수정되었으며
 2016년 08월 02일에 수정되었습니다.


 이 예제는 HL-M1388BB 부품에 맞게 작성되었습니다:

 +----------+--------+-----------+----------------------------------+
 | 매트릭스 |   행   |    열     |            아두이노              |
 | 핀  번호 |        |           |            핀  번호              |
 +----------+--------+-----------+----------------------------------+
 |    2     |   -    |     5     |               13                 |
 +----------+--------+-----------+----------------------------------+
 |    3     |   5    |     -     |               12                 |
 +----------+--------+-----------+----------------------------------+
 |    5     |   -    |     6     |               11                 |
 +----------+--------+-----------+----------------------------------+
 |    6     |   6    |     -     |               10                 |
 +----------+--------+-----------+----------------------------------+
 |    8     |   -    |     7     |      16(아날로그 2번 핀)         |
 +----------+--------+-----------+----------------------------------+
 |    9     |   7    |     -     |      17(아날로그 3번 핀)         |
 +----------+--------+-----------+----------------------------------+
 |   11     |   -    |     8     |      18(아날로그 4번 핀)         |
 +----------+--------+-----------+----------------------------------+
 |   12     |   8    |     -     |      19(아날로그 5번 핀)         |
 +----------+--------+-----------+----------------------------------+
 |   13     |   4    |     -     |                2                 |
 +----------+--------+-----------+----------------------------------+
 |   14     |   -    |     4     |                3                 |
 +----------+--------+-----------+----------------------------------+
 |   16     |   3    |     -     |                4                 |
 +----------+--------+-----------+----------------------------------+
 |   17     |   -    |     3     |                5                 |
 +----------+--------+-----------+----------------------------------+
 |   19     |   2    |     -     |                6                 |
 +----------+--------+-----------+----------------------------------+
 |   20     |   -    |     2     |                7                 |
 +----------+--------+-----------+----------------------------------+
 |   22     |   1    |     -     |                8                 |
 +----------+--------+-----------+----------------------------------+
 |   23     |   -    |     1     |                9                 |
 +----------+--------+-----------+----------------------------------+

 
 이 예제 코드는 공유 저작물입니다.

 http://www.arduino.cc/en/Tutorial/RowColumnScanning

 */

// 2-dimensional array of row pin numbers:
const int row[8] = {
  8, 6, 4, 2, 12, 10, 17, 19
};

// 2-dimensional array of column pin numbers:
const int col[8] = {
  9, 7, 5, 3, 13, 11, 16, 18
};

// 2-dimensional array of pixels:
int pixels[8][24] = 
{
    /*
       ........................ 1
       ..........*...*......... 2
       .........***.***........ 3
       ........*********....... 4
       ........*********....... 5
       .........*******........ 6
       ..........*****......... 7
       ............*........... 8
     */
    { 1, 1, 1, 1, 1, 1, 1, 1, 1, 1, 1, 1, 1, 1, 1, 1, 1, 1, 1, 1, 1, 1, 1, 1},
    { 1, 1, 1, 1, 1, 1, 1, 1, 1, 1, 0, 1, 1, 1, 0, 1, 1, 1, 1, 1, 1, 1, 1, 1},
    { 1, 1, 1, 1, 1, 1, 1, 1, 1, 0, 0, 0, 1, 0, 0, 0, 1, 1, 1, 1, 1, 1, 1, 1},
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    { 1, 1, 1, 1, 1, 1, 1, 1, 1, 1, 1, 1, 0, 1, 1, 1, 1, 1, 1, 1, 1, 1, 1, 1}
};


void setup() {
  // initialize the I/O pins as outputs
  // iterate over the pins:
  for (int thisPin = 0; thisPin < 8; thisPin++) {
    // initialize the output pins:
    pinMode(col[thisPin], OUTPUT);
    pinMode(row[thisPin], OUTPUT);
    // take the col pins (i.e. the cathodes) high to ensure that
    // the LEDS are off:
    digitalWrite(col[thisPin], HIGH);
  }
}


int count = 0;
int pos = 0;

const int COUNT = 5;
const int POS = 24;
const int DELAY = 250;

void loop() {
  
  for(int thisRow = 0; thisRow < 8; thisRow++) {
    
    digitalWrite(row[thisRow], HIGH);

    for (int thisCol = 0; thisCol < 8; thisCol++) {
      int pixel = pixels[thisRow][(thisCol + pos) % POS];

      digitalWrite(col[thisCol], pixel);
      delayMicroseconds(DELAY);
      
      digitalWrite(col[thisCol], HIGH);
    }
    digitalWrite(row[thisRow], LOW);
  }

  ++count;
  if (count > COUNT) {
    count = 0;
    
    ++pos;
    if (pos >= POS) {
      pos = 0;
    }
  }
}

